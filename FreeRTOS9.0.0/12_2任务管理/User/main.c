//FreeRTOS相关文件
#include "FreeRTOS.h"
#include "task.h"
//我们的硬件相关文件
#include "stm32f10x.h"
#include "led.h"
#include "key.h"
#include "usart.h"

/*****************************************************************************************
*																       本章知识
*		1、需要了解的函数：
*		vTaskDelay(延时时间：单位是tick) 1个tick就是一次滴答中断时间
* 					 vTaskDelay用于阻塞延时，调用该函数后，任务将进入阻塞状态，进入阻塞态的任务将让出CPU
*        资源。延时的时长由形参 xTicksToDelay 决定，单位为系统节拍周期，比如系统的时钟节拍周期
*        为 1ms，那么调用vTaskDelay(1)的延时时间则为1ms。
*        (注意：vTaskDelay()延时是相对性的延时，它指定的延时时间是从调用 vTaskDelay()结束后开始
*        计算的，经过指定的时间后延时结束。比如 vTaskDelay(100)， 从调用 vTaskDelay()结束后，
*        任务进入阻塞状态，经过 100 个系统时钟节拍周期后，任务解除阻塞。因此，vTaskDelay()并不
*        适用与周期性执行任务的场合。此外，其它任务和中断活动， 也会影响到 vTaskDelay()的调用
*       （比如调用前高优先级任务抢占了当前任务），进而影响到任务的下一次执行的时间)
*        (注意：使用该函数必须在 FreeRTOSConfig.h 中把 INCLUDE_vTaskDelay 定义为1来使能)
*
*   vTaskDelayUntil(当前时间---指针, 周期时间)
*            在FreeRTOS中，除了相对延时函数，还有绝对延时函数vTaskDelayUntil()，这个绝对延
*        时常用于较精确的周期运行任务，比如我有一个任务， 希望它以固定频率定期执行，而不受外部
* 			 的影响，任务从上一次运行开始到下一次运行开始的时间间隔是绝对的，而不是相对的。
*            任务会先调用vTaskDelayUntil()使任务进入阻塞态，等到时间到了就从阻塞中解除，然后
*        执行主体代码，任务主体代码执行完毕。会继续调用vTaskDelayUntil()使任务进入阻塞态，然
*        后就是循环这样子执行。即使任务在执行过程中发生中断，那么也不会影响这个任务的运行周期，
*        仅仅是缩短了阻塞的时间而已，到了要唤醒的时间依旧会将任务唤醒。
*
*        (注意：使用该函数必须在FreeRTOSConfig.h中把INCLUDE_vTaskDelayUntil定义为1来使能。)
*
*		2、vTaskDelay和vTaskDelayUntil的区别
*            假如有一个任务运行100ms，延时100ms，在没有任何外部干扰(中断或更高优先级任务)的情况下
*        将周期运行。也就是开始时程序运行了0ms，第一次任务运行完成后程序运行了100ms，经历延时后程
*        序运行了200ms，第二任务运行完成后程序运行了300ms，第二延时后程序运行了400ms，第三任务运行
*        完成后程序运行了500ms，第三延时后程序运行了600ms........
*            vTaskDelay和vTaskDelayUntil的区别则在于受到外部干扰(中断或更高优先级任务)的情况下，程
*        序运行ms的变化。
*            假如在三次任务运行受到高优先级任务影响，高优先级任务抢用CPU的10ms使用权：
*            使用vTaskDelay来延时：
*                  开始时程序运行了0ms；
*                  第一次任务运行完成后程序运行了100ms，第一次延时后程序运行了200ms；
*                  第二次任务运行完成后程序运行了300ms，第二次延时后程序运行了400ms；
* 								 第三次任务运行时过程中被更高优先级任务抢用10ms
*                	 第三次任务运行完成后程序运行了510ms，第三次延时后程序运行了610ms；
*                	 第四次任务运行完成后程序运行了710ms，第三次延时后程序运行了810ms；
*            使用vTaskDelayUntil来延时：
*                  开始时程序运行了0ms；
*                  第一次任务运行完成后程序运行了100ms，第一次延时后程序运行了200ms；
*                  第二次任务运行完成后程序运行了300ms，第二次延时后程序运行了400ms；
* 								 第三次任务运行时过程中被更高优先级任务抢用10ms
*                	 第三次任务运行完成后程序运行了510ms，第三次延时后程序运行了600ms(延时时间会缩短为90ms)；
*                	 第四次任务运行完成后程序运行了700ms，第三次延时后程序运行了800ms；
*   
*		1、任务设计要点：
*           作为一个嵌入式开发人员，要对自己设计的嵌入式系统要了如指掌，任务的优先级信息，任务与中
*       断的处理，任务的运行时间、逻辑、状态等都要知道，才能设计出好的系统，所以，在设计的时候需要
*       根据需求制定框架。在设计之初就应该考虑下面几点因素：任务运行的上下文环境、任务的执行时间合
*       理设计。 
*           FreeRTOS 中程序运行的上下文包括：
*  						1-中断服务函数；
*             2-普通任务；
*             3-空闲任务；
*
*       中断服务函数：
*       		  中断服务函数是一种需要特别注意的上下文环境，它运行在非任务的执行环境下（一般为芯片的一
*         种特殊运行模式（也被称作特权模式）），在这个上下文环境中不能使用挂起当前任务的操作，不允许
*         调用任何会阻塞运行的 API 函数接口。另外需要注意的是，中断服务程序最好保持精简短小，快进快出
*         ，一般在中断服务函数中只做标记事件的发生，然后通知任务，让对应任务去执行相关处理，因为中断
*         服务函数的优先级高于任何优先级的任务，如果中断处理时间过长，将会导致整个系统的任务无法正常
*         运行。所以在设计的时候必须考虑中断的频率、中断的处理时间等重要因素，以便配合对应中断处理任
*         务的工作。
*         (总结：
*              1)不能使用挂起当前任务的操作;
*              2)不允许调用任何会阻塞运行的 API 函数接口;
*              3)中断服务程序最好保持精简短小，快进快出;
*              4)必须考虑中断的频率,尽量不要太频繁)
*
*       普通任务：
*             任务看似没有什么限制程序执行的因素，似乎所有的操作都可以执行。但是做为一个优先级明确的
*         实时系统，如果一个任务中的程序出现了死循环操作（此处的死循环是指没有阻塞机制的任务循环体），
*         那么比这个任务优先级低的任务都将无法执行，当然也包括了空闲任务，因为死循环的时候，任务不会
*         主动让出 CPU，低优先级的任务是不可能得到CPU 的使用权的，而高优先级的任务就可以抢占 CPU。这
*         个情况在实时操作系统中是必须注意的一点，所以在任务中不允许出现死循环。如果一个任务只有就绪
*         态而无阻塞态，势必会影响到其他低优先级任务的执行，所以在进行任务设计时，就应该保证任务在不
*         活跃的时候，任务可以进入阻塞态以交出 CPU 使用权，这就需要我们自己明确知道什么情况下让任务
*         进入阻塞态，保证低优先级任务可以正常运行。在实际设计中，一般会将紧急的处理事件的任务优先级
*         设置得高一些。
*         (总结：
*              1)高优先级必须要考虑阻塞时间，好让低优先级有运行时间。
*              2)在实际设计中，一般会将紧急的处理事件的任务优先级设置得高一些。
*              2)紧急的处理事件一般尽力把运行时间设置短,运用频率设置低些(根据情况而定))。
*
*       空闲任务：
*             空闲任务（idle 任务）是 FreeRTOS 系统中没有其他工作进行时自动进入的系统任务。因为处理
*         器总是需要代码来执行——所以至少要有一个任务处于运行态。 FreeRTOS 为了保证这一点，当调用
*         vTaskStartScheduler()时， 调度器会自动创建一个空闲任务，空闲任务是一个非常短小的循环。 用
*         户可以通过空闲任务钩子方式，在空闲任务上钩入自己的功能函数。通常这个空闲任务钩子能够完成一
*         些额外的特殊功能，例如系统运行状态的指示，系统省电模式等。除了空闲任务钩子， FreeRTOS 系统
*         还把空闲任务用于一些其他的功能，比如当系统删除一个任务或一个动态任务运行结束时， 在执行删除
*         任务的时候，并不会释放任务的内存空间，只会将任务添加到结束列表中， 真正的系统资源回收工作在
*         空闲任务完成，空闲任务是唯一一个不允许出现阻塞情况的任务，因为 FreeRTOS 需要保证系统永远都
*         有一个可运行的任务。
*					对于空闲任务钩子上挂接的空闲钩子函数，它应该满足以下的条件：
*              1)永远不会挂起空闲任务。
*              2)不应该陷入死循环，需要留出部分时间用于系统处理系统资源回收。
* 
*       任务的执行时间：
*						  任务的执行时间一般是指两个方面，一是任务从开始到结束的时间，二是任务的周期。在系统设计
*         的时候这两个时间候我们都需要考虑，在我们设计的时候，必须考虑任务的时间和周期，一般来说处理
*         时间更短的任务优先级应设置更高一些。
*                 
******************************************************************************************/

/****************************************************************************** 
*                             什么是任务句柄
* 知识补充：
* 			任务句柄是一个指针，用于指向一个任务，当任务创建好之后，它就具有了一个任务句柄
* 	以后我们要想操作这个任务都需要通过这个任务句柄，如果是自身的任务操作自己，那么
* 	这个句柄可以为NULL。
*
*   说直白点，任务句柄就是一个指向任务控制块的指针，任务控制块存着任务的所有信息
*******************************************************************************/


/*****************************************
*注意：
*    FreeRTOS推荐的最小任务栈为512个字节
*    创建两个128字大小的任务栈
*    1个字等于4个字节
*    FreeRTOS推荐的最小任务栈为512个字节
******************************************/

//创建任务AppTaskCreate的任务句柄
static TaskHandle_t AppTaskCreate_Handle=NULL;
//创建任务AppTaskCreate的任务函数名
static void AppTaskCreate(void);


//LED任务句柄
static TaskHandle_t LED_Task_Handle=NULL;	
//LED任务的任务函数
static void LED_Task(void* parameter);

//KEY任务句柄
static TaskHandle_t KEY_Task_Handle=NULL;	
//KEY任务的任务函数
static void Key_Task(void* parameter);

static void BSP_Init(void);

int main(void)
{
	BaseType_t xReturn = pdPASS;//定义一个创建信息返回值 pdPASS：成功
	
	//硬件初始化
	BSP_Init();    
	printf("硬件初始化完成\r\n");
	
	//动态创建方式创建任务
	//创建任务的操作我们把它交给AppTaskCreate任务来操作，这样方便管理
	xReturn = xTaskCreate(
									(TaskFunction_t	)AppTaskCreate,		      //任务函数
									(const char* 	  )"AppTaskCreate",		    //任务名称
									(uint16_t 		  )128,	                  //任务堆栈大小
									(void* 		  	  )NULL,				          //传递给任务函数的参数
									(UBaseType_t 	  )1, 	                  //任务优先级
									(TaskHandle_t*  )&AppTaskCreate_Handle);//任务句柄  
															
															 
	
	//创建成功就可以开启任务调度器了
	if(xReturn == pdPASS)  vTaskStartScheduler();   /* 启动任务，开启调度 */
	else                   printf("任务创建失败\r\n");
		
	while(1);
}


/*********************************************************************
*函数功能  ：硬件初始化
*函数名    ：BSP_Init
*函数参数  ：void
*函数返回值：static void
*描述      ：
*            所有硬件初始化都写在该函数里。
*            例如：串口初始化、定时器初始化、LED初始、蜂鸣器初始化.....
**********************************************************************/
static void BSP_Init(void)
{
	/*
	* STM32中断优先级分组为4，即4bit都用来表示抢占优先级，范围为：0~15
	* 优先级分组只需要分组一次即可，以后如果有其他的任务需要用到中断，
	* 都统一用这个优先级分组，千万不要再分组，切忌。
	*/
	NVIC_PriorityGroupConfig( NVIC_PriorityGroup_4 );
	
	USART1_Init(115200);
	LED_Init();
	KEY_Init();
}



/*****************************************************
*函数功能  ：任务创建的任务
*函数名    ：AppTaskCreate
*函数参数  ：void
*函数返回值：static void
*描述      ：
*            这个任务创建函数是专门用来创建任务函数的，我
*        们会把它当任务创建，当它把其他任务创建完成后，我
*        们会我们会把该任务销毁。
********************************************************/
static void AppTaskCreate(void)
{
	BaseType_t xReturn = pdPASS;//定义一个创建信息返回值 pdPASS：成功

	//进入临界区，创建任务过程我们必须保证在临界区
	taskENTER_CRITICAL();        
	
	//创建LED_Task任务
	xReturn = xTaskCreate(
								(TaskFunction_t	)LED_Task,		     //任务函数
								(const char* 	  )"LED_Task",		   //任务名称
								(uint32_t 		  )128,					     //任务堆栈大小
								(void* 		  	  )NULL,				     //传递给任务函数的参数
								(UBaseType_t 	  )1, 				       //任务优先级
								(TaskHandle_t*  )&LED_Task_Handle);//任务句柄 
								
	if(xReturn == pdPASS) printf("LED_Task任务创建成功!\r\n");
								
	//创建Key_Task任务
	xReturn = xTaskCreate(
								(TaskFunction_t	)Key_Task,		     //任务函数
								(const char* 	  )"Key_Task",		   //任务名称
								(uint32_t 		  )128,					     //任务堆栈大小
								(void* 		  	  )NULL,				     //传递给任务函数的参数
								(UBaseType_t 	  )2, 				       //任务优先级
								(TaskHandle_t*  )&KEY_Task_Handle);//任务句柄 
																			
	if(xReturn == pdPASS) printf("Key_Task任务创建成功!\r\n");
	
	//删除创建任务AppTaskCreate的任务(就是当前这个函数自己)
	vTaskDelete(AppTaskCreate_Handle);
	//退出临界区
	taskEXIT_CRITICAL();            
}

/*********************************************************************
*函数功能  ：LED相关的操作
*函数名    ：LED_Task
*函数参数  ：void* parameter
*函数返回值：static void
*描述      ：
**********************************************************************/
static void LED_Task(void* parameter)
{
	static TickType_t pxPreviousWakeTime;                 //当前时间
	const TickType_t xTimeIncrement=pdMS_TO_TICKS(500);   //周期
	
	//获取当前时间
	pxPreviousWakeTime = xTaskGetTickCount();
	while (1)
	{
		LED0_ON;
		LED1_OFF;
		vTaskDelayUntil(&pxPreviousWakeTime,xTimeIncrement);
		//vTaskDelay(500);   /* 延时500个tick */
		printf("time1: %d\r\n",xTaskGetTickCount());

		LED0_OFF; 
		LED1_ON; 
		vTaskDelayUntil(&pxPreviousWakeTime,xTimeIncrement);
		//vTaskDelay(500);   /* 延时500个tick */		
		printf("time2: %d\r\n",xTaskGetTickCount()); 		
	}
}


/*********************************************************************
*函数功能  ：按键相关的操作
*函数名    ：Key_Task
*函数参数  ：void* parameter
*函数返回值：static void
*描述      ：
**********************************************************************/
static void Key_Task(void* parameter)
{
	while (1)
	{
		switch(KEY_Scan())
		{
			case 1: 
				printf("挂起LED任务！\r\n");
				vTaskSuspend(LED_Task_Handle);//挂起LED任务
				printf("挂起LED任务成功！\r\n");
				break;
			case 2: 
				printf("恢复LED任务！\r\n");
				vTaskResume(LED_Task_Handle);//恢复LED任务！
				printf("恢复LED任务成功！\r\n");
				break;
			default: break;
		}
		
		vTaskDelay(20);
	}
}

